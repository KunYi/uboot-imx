## board/aaeon/srg-im8p/Kconfig
```kconfig
if TARGET_SRG_IM8P

config SYS_BOARD
	default "srg-im8p"

config SYS_VENDOR
	default "aaeon"

config SYS_CONFIG_NAME
	default "srg-im8p"

config SYS_BOARD_NAME
	string "for board name"
	default "SRG-IM8P"

config SYS_BOARD_REV
	string "for board revision"
	default "EVK"
endif
```

## board/aaeon/srg-imx8p/Kconfig
```kconfig
if TARGET_SRG_IMX8P

config SYS_BOARD
	default "srg-imx8p"

config SYS_VENDOR
	default "aaeon"

config SYS_CONFIG_NAME
	default "srg-imx8p"

config SYS_BOARD_NAME
	string "for board name"
	default "SRG-IMX8P"

config SYS_BOARD_REV
	string "for board revision"
	default "EVK"
endif
```

## board/ubiqconn/bobo9/Kconfig
```kconfig
if TARGET_MX6BOBO9

config SYS_BOARD
	default "bobo9"

config SYS_VENDOR
	default "ubiqconn"

config SYS_SOC
	default "mx6"

config SYS_CONFIG_NAME
	default "bobo9"

endif
```

## board/ubiqconn/dubya/Kconfig
```kconfig
if TARGET_MX6DUBYA

config SYS_BOARD
	default "dubya"

config SYS_VENDOR
	default "ubiqconn"

config SYS_SOC
	default "mx6"

config SYS_CONFIG_NAME
	default "dubya"

endif
```

## board/ubiqconn/tinto/Kconfig
```kconfig
if TARGET_MX6TINTO

config SYS_BOARD
	default "tinto"

config SYS_VENDOR
	default "ubiqconn"

config SYS_SOC
	default "mx6"

config SYS_CONFIG_NAME
	default "tinto"

endif
```

## configs/bobo9_defconfig
```kconfig
CONFIG_ARM=y
CONFIG_ARCH_MX6=y
CONFIG_TARGET_MX6BOBO9=y
CONFIG_SYS_EXTRA_OPTIONS="IMX_CONFIG=board/ubiqconn/bobo9/mx6solo_16x_K4B4G1646D.cfg,MX6SOLO,SYS_NOSMP=\"nosmp\""
CONFIG_SYS_MALLOC_F=y
CONFIG_SYS_MALLOC_F_LEN=0x400
CONFIG_DM=y
CONFIG_DM_THERMAL=y
CONFIG_SYS_PROMPT="bobo9> "
```

## configs/dubya_defconfig
```kconfig
CONFIG_ARM=y
CONFIG_ARCH_MX6=y
CONFIG_TARGET_MX6DUBYA=y
CONFIG_SYS_EXTRA_OPTIONS="IMX_CONFIG=board/ubiqconn/dubya/mx6q_4x_mt41j128.cfg,MX6Q"
CONFIG_CMD_NET=y
CONFIG_CMD_NFS=y
CONFIG_SYS_MALLOC_F=y
CONFIG_SYS_MALLOC_F_LEN=0x400
CONFIG_SYS_PROMPT="DUBYA> "
```

## configs/tinto_defconfig
```kconfig
CONFIG_ARM=y
CONFIG_ARCH_MX6=y
CONFIG_TARGET_MX6TINTO=y
CONFIG_SYS_EXTRA_OPTIONS="IMX_CONFIG=board/ubiqconn/tinto/mx6solo_16x_mt41k256m.cfg,MX6SOLO,SYS_BOOT_SPINOR,SYS_NOSMP=\"nosmp\""
CONFIG_SYS_MALLOC_F=y
CONFIG_SYS_MALLOC_F_LEN=0x400
CONFIG_DM=y
CONFIG_DM_THERMAL=y
CONFIG_MXC_SPI=y
CONFIG_SYS_PROMPT="mx6tinto> "
CONFIG_SYS_CBSIZE=1024
CONFIG_SYS_MAXARGS=256
CONFIG_BOOTDELAY=1
```
